## app/boards/shields/jocatreus/Kconfig.defconfig
```kconfig
# Copyright (c) 2022 The ZMK Contributors
# SPDX-License-Identifier: MIT

if SHIELD_JOCATREUS

config ZMK_KEYBOARD_NAME
    default "jocatreus"
endif
```

## app/boards/shields/jocatreus/Kconfig.shield
```kconfig
# Copyright (c) 2022 The ZMK Contributors
# SPDX-License-Identifier: MIT

config SHIELD_JOCATREUS
    def_bool $(shields_list_contains,jocatreus)
```
